## Documentation/devicetree/bindings/net/dsa/realtek,rtl8372n.yaml
```yaml
# SPDX-License-Identifier: (GPL-2.0-only OR BSD-2-Clause)
%YAML 1.2
---
$id: http://devicetree.org/schemas/net/dsa/realtek,rtl8372n.yaml#
$schema: http://devicetree.org/meta-schemas/core.yaml#

title: Realtek RTL8372N Ethernet Switch

maintainers:
  - Alex Rau <alex@retroduction.org>

description:
  The Realtek RTL8372N is an Ethernet switch with four integrated 2.5GBASE-T
  PHYs on ports 4 to 7 and two 10 Gigabit/s SerDes interfaces on ports 3 and
  8, used to connect external PHYs or SFP cages, or as CPU port. The switch
  is managed over MDIO. Its integrated PHYs, and external PHYs managed through
  the switch, are on the switch internal MDIO bus.

allOf:
  - $ref: dsa.yaml#/$defs/ethernet-ports

properties:
  compatible:
    const: realtek,rtl8372n

  reg:
    maxItems: 1
    description: MDIO address of the switch

  reset-gpios:
    maxItems: 1

  mdio:
    $ref: /schemas/net/mdio.yaml#
    unevaluatedProperties: false

required:
  - compatible
  - mdio
  - reg

unevaluatedProperties: false

examples:
  - |
    mdio {
        #address-cells = <1>;
        #size-cells = <0>;

        ethernet-switch@1d {
            compatible = "realtek,rtl8372n";
            reg = <29>;

            ethernet-ports {
                #address-cells = <1>;
                #size-cells = <0>;

                port@3 {
                    reg = <3>;
                    label = "wan";
                    phy-handle = <&phy1>;
                    phy-mode = "usxgmii";
                };

                port@4 {
                    reg = <4>;
                    label = "lan1";
                    phy-handle = <&phy4>;
                    phy-mode = "internal";
                };

                port@5 {
                    reg = <5>;
                    label = "lan2";
                    phy-handle = <&phy5>;
                    phy-mode = "internal";
                };

                port@6 {
                    reg = <6>;
                    label = "lan3";
                    phy-handle = <&phy6>;
                    phy-mode = "internal";
                };

                port@7 {
                    reg = <7>;
                    label = "lan4";
                    phy-handle = <&phy7>;
                    phy-mode = "internal";
                };

                port@8 {
                    reg = <8>;
                    ethernet = <&gmac0>;
                    phy-mode = "10gbase-r";

                    fixed-link {
                        speed = <10000>;
                        full-duplex;
                    };
                };
            };

            mdio {
                #address-cells = <1>;
                #size-cells = <0>;

                phy1: ethernet-phy@1 {
                    compatible = "ethernet-phy-ieee802.3-c45";
                    reg = <1>;
                };

                phy4: ethernet-phy@4 {
                    compatible = "ethernet-phy-ieee802.3-c45";
                    reg = <4>;
                };

                phy5: ethernet-phy@5 {
                    compatible = "ethernet-phy-ieee802.3-c45";
                    reg = <5>;
                };

                phy6: ethernet-phy@6 {
                    compatible = "ethernet-phy-ieee802.3-c45";
                    reg = <6>;
                };

                phy7: ethernet-phy@7 {
                    compatible = "ethernet-phy-ieee802.3-c45";
                    reg = <7>;
                };
            };
        };
    };
```
